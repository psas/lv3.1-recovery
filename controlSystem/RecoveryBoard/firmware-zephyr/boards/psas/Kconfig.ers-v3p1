## controlSystem/RecoveryBoard/firmware-zephyr/boards/psas/Kconfig.ers-v3p1
```kconfig
# Copyright (c) 2025 Portland State Aerospace Society
# SPDX-License-Identifier: Apache-2.0

config BOARD_ERS_V3P1
        select SOC_STM32F091XC
```

## controlSystem/RecoveryBoard/firmware-zephyr/dts/bindings/psas,ers-gpios.yml
```yaml
description: Electromechanical Recovery System (ERS) GPIO parent node

compatible: "psas,ers-gpios"

include: base.yaml

child-binding:
  description: |
    ERS GPIOs child node to express an individual GPIO pin.
  properties:
    gpios:
      type: phandle-array
      required: true
      desciption: pin specifier in the format '<port-handle pin flags>'.
```

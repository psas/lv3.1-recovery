## controlSystem/RecoveryBoard/firmware-zephyr/apps/Kconfig.dac
```kconfig
# @file
# @brief ERS Zephyr digital-to-analog module configuration file.

menuconfig ERS_DAC
	bool "ERS DAC module app settings"
	default y
	help
	  Enable ERS symbols to configure the digital-to-analog (DAC) module.

if ERS_DAC

config DAC_MUTEX_TIMEOUT_MS
	int "DAC module default mutex timeout in milliseconds"
	default 1000
	help
	  Set the DAC module mutex timeout, measured in milliseconds.

endif # ERS_DAC

module = ERS_DAC
module-str = DAC module
source "subsys/logging/Kconfig.template.log_config"
```

## controlSystem/RecoveryBoard/firmware-zephyr/apps/Kconfig.gpio-in
```kconfig
# @file
# @brief ERS Zephyr GPIO module configuration file.

menuconfig ERS_GPIO
	bool "ERS GPIO module settings"
	default y
	help
	  Enable ERS symbols to configure the digital-to-analog (DAC) module.

if ERS_GPIO

config GPIO_THREAD_SLEEP_MS
	int "GPIO module thread 'forever loop' sleep period."
	default 100
	help
	  Set the GPIO module thread's main loop interval, a sleep period.
	  This interval must be set small enough for drogue and main parachute
	  firmware versions to be responsive to digital input changes from
	  the avionics system.

config DIGITAL_IN_SUMMARY_REPORT
	bool "Enable GPIO input summary report."
	help
	  Enable GPIO input summary report.  May create a lot of rapid messages
	  depending on the GPIO thread's main loop sleep period.

endif # ERS_GPIO

module = ERS_GPIO
module-str = GPIO module
source "subsys/logging/Kconfig.template.log_config"
```

## controlSystem/RecoveryBoard/firmware-zephyr/apps/Kconfig.keeper
```kconfig
# @file
# @brief App configuration for ERS keeper module, a data store.

menuconfig ERS_KEEPER_MODULE
	bool "ERS keeper module settings"
	default y
	help
	  Enable and configure ERS keeper module.  Enabled by default as it is
	  critical to correct, full system operation.

if ERS_KEEPER_MODULE

config KEEPER_API_TIMEOUT_MS
	int "Keeper public API timeout in milliseconds"
	default 1500
	help
	  Set a timeout measured in milliseconds for the ERS Zephry keeper
	  module public API.

endif # ERS_KEEPER_MODULE

module = keeper
module-str = ERS keeper module
source "subsys/logging/Kconfig.template.log_config"
```

## controlSystem/RecoveryBoard/firmware-zephyr/apps/Kconfig.motor_control
```kconfig
# @file
# @brief Application configuration for ERS motor control module

menuconfig ERS_MOTOR_CONTROL
        bool "ERS motor control module settings"
        default y
        help
          Enable and configure ERS motor control module.

if ERS_MOTOR_CONTROL

config MC_MUTEX_TIMEOUT_MS
	int "Motor control module mutex timeout in milliseconds"
	default 1000
	help
	  Set motor control module mutex timeout, measured in milliseconds.

config MC_DAC_OUTPUT_FOR_CURRENT_LIMIT
	int "DAC output setting, used to limit lock ring motor current."
	default 740
	help
	  Set limit on driving current for lock ring motor.  Per ERS specification
	  calculations, based on MOTOR_ILIM net voltage and voltage divider at
	  the motor driver IC, DAC count of 740 produces about 1 amp current out
	  of the motor driver chip.

config MC_RING_CHECK_INTERVAL_MS
	int "Interval between ring position checks during lock and unlock ops."
	default 5
	help
	  Set an interval between ring position checks, those which occur in the
	  motor control module during ring lock and ring unlock operations.  May
	  need to be adjusted, per bench top tests and observations.

config MC_COUNT_RING_CHECKS
	int ""
	default 60
	help
	  Set the maximum planned count of lock ring position checks to perform,
	  during a lock ring, and an unlock ring operation.  Note that not all
	  checks may be performed, in cases where the long ring reaches its
	  desired new position in fewer checks and ring check time intervals.

endif # ERS_MOTOR_CONTROL

module = MOTOR_CONTROL
module-str = motor control module
source "subsys/logging/Kconfig.template.log_config"
```

## controlSystem/RecoveryBoard/firmware-zephyr/apps/Kconfig.pwm
```kconfig
# @file
# @brief Application configuration for ERS PWM module

menuconfig ERS_PWM_MODULE
	bool "ERS PWM module settings"
	default y
	help
	  Enable and configure ERS PWM module.

if ERS_PWM_MODULE

config PWM_API_TIMEOUT_MS
	int "PWM public API timeout in milliseconds"
	default 1500
	help
	  Set a timeout measured in milliseconds for the ERS Zephry PWM public
	  API.

config PWM_FOREVER_LOOP_SLEEP_MS
	int "Period for which PWM 'forever' loop sleep after performing work"
	default 750
	help
	  Set the period for which the PWM module sleeps at the end of
	  completing its tasks.

endif # ERS_PWM_MODULE

module = ERS_PWM
module-str = ERS PWM module
source "subsys/logging/Kconfig.template.log_config"
```

## controlSystem/RecoveryBoard/firmware-zephyr/apps/Kconfig.settings-ers
```kconfig
# @file
# @brief Application configuration for settings module.

menuconfig ERS_SETTINGS_MODULE
	bool "ERS settings module configuration"
	default y
	help
	  Enable and configure ERS settings module, which supports read and
	  write access to flash memory for persistent storage.

if ERS_SETTINGS_MODULE

config SETTINGS_API_TIMEOUT_MS
	int "Settings public API timeout in milliseconds"
	default 1500
	help
	  Set a timeout measured in milliseconds for the ERS settings public
	  API.

endif # ERS_SETTINGS_MODULE

module = ERS_SETTINGS
module-str = settings module
source "subsys/logging/Kconfig.template.log_config"
```

## controlSystem/RecoveryBoard/firmware-zephyr/apps/Kconfig.status_led
```kconfig
# @file
# @brief ERS Zephyr status LED module configuration file.

menuconfig ERS_STATUS_LED
	bool "ERS status LED settings"
	default y
	help
	  Enable ERS symbols to configure the status LED module.

if ERS_STATUS_LED

config STATUS_LED_MUTEX_TIMEOUT_MS
	int "Status LED API default mutex timeout in milliseconds"
	default 1000
	help
	  Set the status LED API mutex timeout, measured in milliseconds.

endif # ERS_STATUS_LED

module = STATUS_LED
module-str = status LED module
source "subsys/logging/Kconfig.template.log_config"
```

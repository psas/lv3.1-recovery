## sample.yaml
```
sample:
  description: Hello World sample, the simplest Zephyr
    application
  name: hello world
common:
  tags: introduction
  integration_platforms:
    - nucleo_f091rc
    - ers-v3p1
  harness: console
  harness_config:
    type: one_line
    regex:
      - "Hello World! (.*)"
tests:
  sample.basic.helloworld:
    tags: introduction
```

## prj.conf
```kconfig
# ERS board bring-up Kconfig overlay
#
# Notes
# (1) See ers-v3p1_defconfig for default board Kconfig settings.
# (2) This file is the conventional place in a Zephyr based application source
#   tree to enable Kconfig symboles, many of which refer to programmatic,
#   hardware independent app and library features.
```

## boards/ers-v3p1.overlay
```dts
// PSAS Electromechanical Recovery System (ERS) board DTS overlay

&gpioa {
        status = "okay";
};

&gpiob {
        status = "okay";
};

&gpiof {
        status = "okay";
};
```

## src/main.c
```c
/*
 * Copyright (c) 2012-2014 Wind River Systems, Inc.
 *
 * SPDX-License-Identifier: Apache-2.0
 */

#include <stdio.h>

#include <zephyr/kernel.h>

int main(void)
{
	static uint32_t loop_count = 0;

	while (1)
	{
		loop_count++;
		printk("Hello World! %s iter %u\n", CONFIG_BOARD_TARGET, loop_count);
		k_msleep(1000);
	}

	return 0;
}
```
